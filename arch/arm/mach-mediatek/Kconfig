## arch/arm/mach-mediatek/Kconfig
```kconfig
# SPDX-License-Identifier: GPL-2.0-only
menuconfig ARCH_MEDIATEK
	bool "MediaTek SoC Support"
	select ARM_GIC
	select ARM_GIC_V3
	select GENERIC_TIME
	select GENERIC_CLOCKEVENTS
	select ARCH_HAS_CPUFREQ
	select ARM_AMBA
	select IRQ_DOMAIN
	select GENERIC_SCHED_CLOCK
	select ARMV7_COMPAT
	select ARMV7_COMPAT_CPUINFO
	select CPU_IDLE
	select NEON
	select VFP
	select KERNEL_MODE_NEON
	select PINCTRL
	help
	  Support for Mediatek MT65xx & MT81xx SoCs

if ARCH_MEDIATEK

config MACH_MT2701
	bool "MediaTek MT2701 SoCs support"
	default ARCH_MEDIATEK

config MACH_MT6589
	bool "MediaTek MT6589 SoCs support"
	default ARCH_MEDIATEK

config MACH_MT6592
	bool "MediaTek MT6592 SoCs support"
	default ARCH_MEDIATEK

config MACH_MT7623
	bool "MediaTek MT7623 SoCs support"
	default ARCH_MEDIATEK

config MACH_MT7629
	bool "MediaTek MT7629 SoCs support"
	default ARCH_MEDIATEK
	select HAVE_ARM_ARCH_TIMER

config MACH_MT8127
	bool "MediaTek MT8127 SoCs support"
	default ARCH_MEDIATEK

config MACH_MT8135
	bool "MediaTek MT8135 SoCs support"
	default ARCH_MEDIATEK

endif
```

## drivers/input/hall/Kconfig
```kconfig
config SENSORS_SIMULATED_HALL
	tristate "for oplus hall"
	default n
	help
	  It support sensor_hall.
```

## drivers/input/touchscreen/oplus_touchscreen_v2/Synaptics/Kconfig
```kconfig
source "drivers/input/touchscreen/oplus_touchscreen_v2/Synaptics/Syna_tcm_S3910/Kconfig"
```

## drivers/misc/mediatek/aw37004/Kconfig
```kconfig
config MTK_CAMERA_LDO
	tristate "Mediatek camera ldo driver"
	default n
	help
	  This is CAMERA ldo driver.
```

## drivers/misc/mediatek/boot_common/Kconfig
```kconfig
config MTK_BOOT_COMMON
	tristate "config boot mode common info for kernel"
	default m
	help
	  define this config to define boot mode common
```

## drivers/misc/mediatek/cameraisp/src/Kconfig
```kconfig
config MTK_CAMERA_ISP_RAW_SUPPORT
	tristate "[ISP] Image Signal Processor"
	depends on MTK_CAMERA_ISP_SUPPORT
	help
	  Enable to build camera isp p1 driver which
	  processes and enhances the image raw data
	  from the imgsensor.
	  Disable if it is not supported or not wanted.

config MTK_ISP_IRQ_CONTROLLER
	tristate "[ISP] Image Signal Processor Irq Controller"
	help
	  Enable to build camera isp p1 driver which
	  processes and enhances the image raw data
	  from the imgsensor.
	  Disable if it is not supported or not wanted.
```

## drivers/misc/mediatek/flashlight/v4l2/Kconfig
```kconfig
config MTK_VIDEO_LM3643
	tristate "LM3643 dual flash driver support"
	depends on I2C && VIDEO_V4L2 && MEDIA_CONTROLLER
	depends on MEDIA_CAMERA_SUPPORT
	select REGMAP_I2C
	help
	  This is a driver for the lm3643 dual flash controllers. It controls
	  flash, torch LEDs.

	  Say Y here if you want a flashlight driver IC LM3643.
	  Select this only if your board has this IC.
	  Say M here if you want to compile this driver as a module.

config MTK_VIDEO_LM3644
	tristate "LM3644 dual flash driver support"
	depends on I2C && VIDEO_V4L2 && MEDIA_CONTROLLER
	depends on MEDIA_CAMERA_SUPPORT
	select REGMAP_I2C
	help
	  This is a driver for the lm3644 dual flash controllers. It controls
	  flash, torch LEDs.

	  Say M here if you want to compile this driver as a module.

config MTK_VIDEO_SY7806
	tristate "SY7806 dual flash driver support"
	depends on I2C && VIDEO_V4L2 && MEDIA_CONTROLLER
	depends on MEDIA_CAMERA_SUPPORT
	select REGMAP_I2C
	help
	  This is a driver for the sy7806 dual flash controllers. It controls
	  flash, torch LEDs.

	  Say M here if you want to compile this driver as a module.

config MTK_VIDEO_KTD2687
	tristate "KTD2687 dual flash driver support"
	depends on I2C && VIDEO_V4L2 && MEDIA_CONTROLLER
	depends on MEDIA_CAMERA_SUPPORT
	select REGMAP_I2C
	help
	  This is a driver for the ktd2687 dual flash controllers. It controls
	  flash, torch LEDs.

	  Say M here if you want to compile this driver as a module.

config MTK_VIDEO_AW36515
	tristate "AW36515 dual flash driver support"
	depends on I2C && VIDEO_V4L2 && MEDIA_CONTROLLER
	depends on MEDIA_CAMERA_SUPPORT
	select REGMAP_I2C
	help
	  This is a driver for the aw36515 dual flash controllers. It controls
	  flash, torch LEDs.

	  Say M here if you want to compile this driver as a module.

config MTK_VIDEO_AW36518
	tristate "AW36518 flash driver support"
	depends on I2C && VIDEO_V4L2 && MEDIA_CONTROLLER
	depends on MEDIA_CAMERA_SUPPORT
	select REGMAP_I2C
	help
	  This is a driver for the aw36518 flash controllers. It controls
	  flash, torch LEDs.

	  Say M here if you want to compile this driver as a module.

config MTK_VIDEO_AW36515_21121
	tristate "AW36515 dual flash driver support"
	depends on I2C && VIDEO_V4L2 && MEDIA_CONTROLLER
	depends on MEDIA_CAMERA_SUPPORT
	select REGMAP_I2C
	help
	  This is a driver for the aw36515_21121 dual flash controllers. It controls
	  flash, torch LEDs.

	  Say M here if you want to compile this driver as a module.

config MTK_VIDEO_AW36515_22021
	tristate "AW36515 dual flash driver support"
	depends on I2C && VIDEO_V4L2 && MEDIA_CONTROLLER
	depends on MEDIA_CAMERA_SUPPORT
	select REGMAP_I2C
	help
	  This is a driver for the aw36515_21121 dual flash controllers. It controls
	  flash, torch LEDs.

	  Say M here if you want to compile this driver as a module.

config MTK_VIDEO_AW36515_22921
	tristate "AW36515 dual flash driver support"
	depends on I2C && VIDEO_V4L2 && MEDIA_CONTROLLER
	depends on MEDIA_CAMERA_SUPPORT
	select REGMAP_I2C
	help
	  This is a driver for the aw36515_22921 dual flash controllers. It controls
	  flash, torch LEDs.

	  Say M here if you want to compile this driver as a module.

config MTK_VIDEO_AW36515_22017
	tristate "AW36515 dual flash driver support"
	depends on I2C && VIDEO_V4L2 && MEDIA_CONTROLLER
	depends on MEDIA_CAMERA_SUPPORT
	select REGMAP_I2C
	help
	  This is a driver for the aw36515_22017 dual flash controllers. It controls
	  flash, torch LEDs.

	  Say M here if you want to compile this driver as a module.

config MTK_VIDEO_AW36518_22282
	tristate "AW36518 flash driver support"
	depends on I2C && VIDEO_V4L2 && MEDIA_CONTROLLER
	depends on MEDIA_CAMERA_SUPPORT
	select REGMAP_I2C
	help
	  This is a driver for the aw36515_22282 flash controllers. It controls
	  flash, torch LEDs.

	  Say M here if you want to compile this driver as a module.

config MTK_VIDEO_LM3642_22823
	tristate "LM3642 flash driver support"
	depends on I2C && VIDEO_V4L2 && MEDIA_CONTROLLER
	depends on MEDIA_CAMERA_SUPPORT
	select REGMAP_I2C
	help
	  This is a driver for the aw36515_22282 flash controllers. It controls
	  flash, torch LEDs.

	  Say M here if you want to compile this driver as a module.
```

## drivers/misc/mediatek/imgsensor/oplus/Kconfig
```kconfig
# SPDX-License-Identifier: GPL-2.0
config OPLUS_CAM_EVENT_REPORT
	tristate "config oplus camera event report"
	default n
	help
		Say Y to include support
config OPLUS_EVENT_REPORT
	bool "event report support"
	default n
	help
		Say Y to include support
```

## drivers/misc/mediatek/sensor/2.0/hall/Kconfig
```kconfig
config SENSOR_MXM1120_HALL
	tristate "for oplus hall"
	default n
	help
	  It support sensor_hall.
```

## drivers/misc/mediatek/wl2868c/Kconfig
```kconfig
config MTK_CAMERA_LDO
	tristate "Mediatek camera ldo driver"
	default n
	help
	  This is CAMERA ldo driver.

config REGULATOR_OPLUS_WL2868C_FP_LDO
	bool "Fingerprint uses LDO of WL2868C"
	depends on MTK_CAMERA_LDO
	default n
	help
	  Say Y here to agree that the fingerprint supports the
	  WL2868C PMIC chip.
```

## drivers/nfc/oplus_nfc/Kconfig
```kconfig
# SPDX-License-Identifier: GPL-2.0
config OPLUS_NFC
  tristate "config oplus nfc chipset"
  default n
  help
	define this config to get chipset version from dts.
```

## drivers/power/Kconfig
```kconfig
# SPDX-License-Identifier: GPL-2.0-only
source "drivers/power/reset/Kconfig"
source "drivers/power/supply/Kconfig"

menuconfig OPLUS_CHG_V2
	tristate "OPLUS charging V2 system"
	default n
	depends on I2C
	select REGMAP_I2C
	help
	  Say Y here to enable OPLUS charging V2 system support

config OPLUS_CHG
	tristate "OPLUS CHARGER KO module"
	default m
	help
	  Enables support for the oplus charging framework

config OPLUS_CHARGER
	bool "OPLUS_CHARGER"
	default n
	help
	  Set Yes to support OPLUS_CHARGER features
	  smart battery.
	  Set No to disable OPLUS_CHARGER features
	  smart battery.

config OPLUS_CHG
	tristate "OPLUS CHARGER KO module"
	default m
	help
	  Enables support for the oplus charging framework

config OPLUS_CHARGER_MTK
	bool "OPLUS charger on MTK"
	default n
	help
	  Say Yes here to declare charging system is on MTK
	  Say No here to declare charging system is not on MTK

config OPLUS_CHARGER_MTK_CHGIC
	bool "OPLUS_CHARGER_MTK_CHG_IC"
	default n
	help
	  Say Yes to use MTK platform charger ic
	  Say No to use extern charger ic

config OPLUS_CHARGER_MTK6983S
	bool "OPLUS_CHARGER_MTK6983S"
	default n
	help
	  Set yes to support OPLUS_CHARGER_MTK6983S features
	  smart battery.
	  Set No to disable OPLUS_CHARGER_MTK6983S features
	  smart battery.

config OPLUS_CHARGER_MTK6789S
	bool "OPLUS_CHARGER_MTK6789S"
	default n
	help
	  Set yes to support OPLUS_CHARGER_MTK6789S features
	  smart battery.
	  Set No to disable OPLUS_CHARGER_MTK6789S features
	  smart battery.

config OPLUS_CHARGER_MTK6895S
	bool "OPLUS_CHARGER_MTK6895S"
	default n
	help
	  Set yes to support OPLUS_CHARGER_MTK6895S features
	  smart battery.
	  Set No to disable OPLUS_CHARGER_MTK6895S features
	  smart battery.

config OPLUS_CHARGER_MTKAGING
	bool "OPLUS_CHARGER_MTKAGING"
	default n
	help
	  Set yes to support amend mtk aging algo features
	  Set No to disable OPLUS_CHARGER_MTKAGING features

config OPLUS_HVDCP_SUPPORT
        bool "OPLUS_HVDCP_SUPPORT"
        default n
        help
          Set yes to support hvdcp.

config OPLUS_CHECK_CHARGERID_VOLT
	bool "OPLUS_CHECK_CHARGERID_VOLT"
	default n
	help
	  Set yes to support OPLUS_CHECK_CHARGERID_VOLT features
	  smart battery.
	  Set No to disable OPLUS_CHECK_CHARGERID_VOLT features
	  smart battery.

config OPLUS_4400MV_BATTERY_SUPPORT
	bool "OPLUS_CHECK_CHARGERID_VOLT"
	default n
	help
	  Set yes to support BATTERYID features
	  smart battery.
	  Set No to disable BATTERYID features
	  smart battery.

config OPLUS_CALL_MODE_SUPPORT
	bool "OPLUS call mode support"
	default n
	help
	  Say Y to enable support for the oplus call mode.

config OPLUS_CALL_MODE_SUPPORT
	bool "OPLUS call mode support"
	help
	  Say Y to enable support for the oplus call mode.

config OPLUS_SHIP_MODE_SUPPORT
	bool "OPLUS ship mode support"
	default n
	help
	  Say Y to include support

config OPLUS_SHORT_HW_CHECK
	bool "OPLUS batt HW SHORT"
	default n
	help
	  Say Y to include support

config OPLUS_SMART_CHARGER_SUPPORT
        bool "OPLUS Smart Charger support"
        default n
        help
          Say Y to include support

config OPLUS_SHORT_IC_CHECK
	bool "OPLUS batt short "
	help
	  Say Y here to declare charging system is on MTK

config OPLUS_CHG_DYNAMIC_CONFIG
	bool "OPLUS_CHG_DYNAMIC_CONFIG"
	default n
	help
	  Say Y to include support

config MTK_KERNEL_POWER_OFF_CHARGING
	bool "MTK kernel power off charging"
	default n
	help
	  yes : support KPOC feature, power off charging would running by
	  kernel and charging animation by kpoc service. no: not support KPOC
	  feature.
	  device won't enter charging mode if config is no.

config OPLUS_MTK_DRM_GKI_NOTIFY_CHG
        bool "OPLUS mtk drm gki notify chg"
        default n
        help
          Say Y to include support

#add from v2
config OPLUS_CHG_IC_DEBUG
	bool "Virtual IC layer debug interface"
	default n
	help
	  Say Y here to declare virtual IC layer debug interface

config OPLUS_CHG_MMS_DEBUG
	bool "Message subscription layer debug interface"
	default n
	help
	  Say Y here to declare message subscription layer debug interface

config OPLUS_DA9313_CHARGER
	bool "DA9313 support"
	default n
	help
	  Say Y here to declare DA9313 support

config OPLUS_MP2762_CHARGER
	bool "MP2762 support"
	default n
	help
	  Say Y here to declare MP2762 support

config OPLUS_SGM41512_CHARGER
	bool "SGM41512 support"
	default n
	help
	  Say Y here to declare SGM41512 support

config OPLUS_PD_MANAGER_CHARGER
	bool "PD_MANAGER support"
	default n
	help
	  Say Y here to declare PD_MANAGER support

config OPLUS_ADSP_CHARGER
	bool "ADSP support"
	default n
	help
	  Say Y here to declare ADSP support

config OPLUS_MT6375_CHARGER
	bool "MT6375 debug support"
	default n
	help
	  Say Y here to declare MT6375 debug support

config OPLUS_CHARGER_OPTIGA
	bool "OPLUS OPTIGA soc node"
	help
	  Say Y to include support

config OPLUS_CHIP_SOC_NODE
	bool "OPLUS chip soc node"
	help
	  Say Y to include support

config OPLUS_CHG_VOOCPHY
	bool "OPLUS CHG VOOCPHY"
	default n
	help
	  Say Y here to declare OPLUS CHG VOOCPHY support

config OPLUS_CHG_AP_VOOCPHY
	bool "OPLUS AP VOOCPHY"
	default n
	help
	  Say Y here to declare OPLUS AP VOOCPHY support

config OPLUS_CHG_VOOCPHY_CHGLIB
	bool "OPLUS CHGLIB VOOCPHY"
	default n
	help
	  Say Y here to declare OPLUS AP CHGLIB support

config OPLUS_VOOCPHY_SC8517
	bool "OPLUS SC8517 VOOCPHY"
	default n
	help
	  Say Y here to declare OPLUS SC8517 VOOCPHY support

config OPLUS_UFCS_SC8547A
	bool "OPLUS VOOCPHY SC8547A"
	default n
	help
	  Say Y here to declare OPLUS SC8547A-ufcs support

config OPLUS_VOOCPHY_SLAVE_SC8547
	bool "OPLUS VOOCPHY SLAVE SC8547"
	default n
	help
	  Say Y here to declare OPLUS SLAVE SC8547 support

config OPLUS_UFCS_CLASS
	tristate "OPLUS CHARGER UFCS KO module"
	default n
	help
	  Enables support for the oplus charging framework

config OPLUS_UFCS_MASTER_NU2112A
	bool "OPLUS VOOCPHY NU2112A"
	default n
	help
	  Say Y here to declare OPLUS MASTER NU2112A support

config OPLUS_UFCS_SLAVE_NU2112A
	bool "OPLUS VOOCPHY SLAVE NU2112A"
	default n
	help
	  Say Y here to declare OPLUS SLAVE NU2112A support

config OPLUS_CHARGER_MAXIM
	bool "encryption ic maxim support"
	help
	  Say Y here to declare encryption ic maxim support
source "drivers/power/oplus/test-kit/Kconfig"
source "drivers/power/oplus/config/Kconfig"
```
