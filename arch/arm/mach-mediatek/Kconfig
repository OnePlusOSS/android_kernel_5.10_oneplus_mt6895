## drivers/scsi/ufs/vendor/Kconfig
```kconfig
config UFSFEATURE
	bool "UFS feature activate"
	depends on SCSI_UFSHCD
	help
	  UFS feature activate such as hpb, tw and etc.

config UFSSHPB
	bool "UFS Samsung Host Performance Booster support"
	depends on SCSI_UFSHCD && UFSFEATURE
	help
	  UFS HPB Feature Enable

config HPB_DEBUG
	bool "HPB Debug Log Enable"
	depends on SCSI_UFSHCD && UFSFEATURE && UFSSHPB
	default n
	help
	  UFS HPB Debug Enable (dmesg log[=if set debug sysfs] & BLK_TRACE msg)

config HPB_DEBUG_SYSFS
	bool "HPB Debug sysfs"
	depends on SCSI_UFSHCD && UFSFEATURE && UFSSHPB
	default n
	help
	  UFS HPB Debug Sysfs Enable

config HPB_ERR_INJECTION
	bool "HPB ERROR INJECTION"
	depends on SCSI_UFSHCD && UFSFEATURE && UFSSHPB
	help
	  error injection for checking HPB entry integrity

config UFSTW
	bool "UFS Turbo Write support"
	depends on SCSI_UFSHCD && UFSFEATURE
	help
	  UFS TW Feature Enable

config UFSTW_DEBUG
	bool "TW Debug Log Enable"
	depends on SCSI_UFSHCD && UFSFEATURE && UFSTW
	default n
	help
	  UFS TW Debug Enable (dmesg log[=if set debug sysfs] & BLK_TRACE msg)

config UFSTW_IGNORE_GUARANTEE_BIT
	bool "Ignore UFS Turbo Write Life Time Guarantee bit for POC"
	default n
	depends on SCSI_UFSHCD && UFSFEATURE && UFSTW
	help
	  ignore the guarantee bit[31] of dTurboWriteBufferLifeTimeEst for PoC

config UFSTW_BOOT_ENABLED
	bool "Turbo Write enabled at boot time"
	default y
	depends on SCSI_UFSHCD && UFSFEATURE && UFSTW
	help
	  fTurboWriteEn and fTurboWriteBufferFlushDuringHibnerEnter flags
	  are enabled at boot time.

config UFSTW_RESTORE_WB
	bool "Restore Write Booster for unsupported TW version"
	default y
	depends on SCSI_UFSHCD && UFSFEATURE && UFSTW
	help
	  Restoring Write Booster when TW initialization is failed.

config UFSHID
	bool "UFS Host Initiated Defrag support"
	depends on SCSI_UFSHCD && UFSFEATURE
	help
	  UFS HID Feature Enable

config UFSHID_POC
	bool "UFSHID_POC test"
	depends on SCSI_UFSHCD && UFSFEATURE && UFSHID
	help
	  UFS HID POC test
	  1. block to enter suspend state
	  2. auto_hibern8 enable/disable (HCI)
	  3. set flag bDefragOperation
	  4. debug msg enable (default : disable)

config UFSSID
	bool "UFS Stream ID support"
	depends on SCSI_UFSHCD && UFSFEATURE && UFSHID
	help
	  Enable Stream ID Feature for Streamed-HID


config UFSRINGBUF
	bool "UFS RingBuffer support"
	depends on SCSI_UFSHCD && UFSFEATURE
	help
	  UFS RingBuffer Feature Enable

config UFSRINGBUF_POC
	bool "UFS RingBuffer POC test"
	depends on SCSI_UFSHCD && UFSFEATURE && UFSRINGBUF
	help
	  UFS RingBuffer POC test
	  1. set default vendor_signature & vendor_parameter for test
	  2. Set custom vender_parameter
```

## drivers/soc/Kconfig
```kconfig
# SPDX-License-Identifier: GPL-2.0-only
menu "SOC (System On Chip) specific Drivers"

source "drivers/soc/actions/Kconfig"
source "drivers/soc/amlogic/Kconfig"
source "drivers/soc/aspeed/Kconfig"
source "drivers/soc/atmel/Kconfig"
source "drivers/soc/bcm/Kconfig"
source "drivers/soc/fsl/Kconfig"
source "drivers/soc/imx/Kconfig"
source "drivers/soc/ixp4xx/Kconfig"
source "drivers/soc/mediatek/Kconfig"
source "drivers/soc/qcom/Kconfig"
source "drivers/soc/renesas/Kconfig"
source "drivers/soc/rockchip/Kconfig"
source "drivers/soc/samsung/Kconfig"
source "drivers/soc/sifive/Kconfig"
source "drivers/soc/sunxi/Kconfig"
source "drivers/soc/tegra/Kconfig"
source "drivers/soc/ti/Kconfig"
source "drivers/soc/ux500/Kconfig"
source "drivers/soc/versatile/Kconfig"
source "drivers/soc/xilinx/Kconfig"
source "drivers/soc/zte/Kconfig"
source "drivers/soc/kendryte/Kconfig"

#ifdef OPLUS_BUG_STABILITY
source "drivers/soc/oplus/system/Kconfig"
#endif /* OPLUS_BUG_STABILITY */

#ifdef OPLUS_DFR_FEATURE
source "drivers/soc/oplus/dfr/Kconfig"
#endif /* OPLUS_DFR_FEATURE */

#ifdef OPLUS_BOOT_FEATURE
source "drivers/soc/oplus/boot/Kconfig"
#endif /* OPLUS_BOOT_FEATURE */

#ifdef OPLUS_DFT_FEATURE
source "drivers/soc/oplus/dft/Kconfig"
#endif /* OPLUS_DFT_FEATURE */

#ifdef OPLUS_TP_BASIC
source "drivers/soc/oplus/device_info/Kconfig"
#endif /*#ifdef OPLUS_TP_BASIC*/

#ifdef OPLUS_FEATURE_MIDAS_GKI
source "drivers/soc/oplus/midas/Kconfig"
#endif /* OPLUS_FEATURE_MIDAS_GKI */

#ifdef OPLUS_FEATURE_HANS
source "drivers/soc/oplus/hans/Kconfig"
#endif /* OPLUS_FEATURE_HANS */

#ifdef OPLUS_FEATURE_OMRG
source "kernel/oplus_cpu/oplus_omrg/Kconfig"
#endif /* OPLUS_FEATURE_OMRG */

#ifdef OPLUS_FEATURE_FREQQOS_MONITOR
source "kernel/oplus_cpu/freqqos_monitor/Kconfig"
#endif /* OPLUS_FEATURE_FREQQOS_MONITOR */

#ifdef OPLUS_FEATURE_GKI_CPUFREQ_BOUNCING
source "kernel/oplus_cpu/cpufreq_bouncing/Kconfig"
#endif /* OPLUS_FEATURE_GKI_CPUFREQ_BOUNCING */

#ifdef OPLUS_FEATURE_ABNORMAL_FLAG
source "kernel/oplus_cpu/oplus_overload/Kconfig"
#endif /* OPLUS_FEATURE_ABNORMAL_FLAG*/

source "drivers/soc/oplus/uad/Kconfig"
#ifdef OPLUS_FEATURE_MM_FEEDBACK
source "drivers/soc/oplus/oplus_mm_fb/Kconfig"
#endif /* OPLUS_FEATURE_MM_FEEDBACK */

#ifdef OPLUS_FEATURE_STORAGE_IO_METRICS
source "drivers/soc/oplus/storage/Kconfig"
#endif /*OPLUS_FEATURE_STORAGE_IO_METRICS*/

#ifdef OPLUS_FEATURE_WAKER_IDENTIFY
source "kernel/oplus_cpu/waker_identify/Kconfig"
#endif /*OPLUS_FEATURE_WAKER_IDENTIFY*/

endmenu
```

## drivers/soc/oplus/device_info/Kconfig
```kconfig
config MTK_PLATFORM
       default n
       tristate "devinfo mtk platfrom"

config OPLUS_FEATURE_OPROJECT
       default n
       tristate "devinfo config feature oproject"

config OPLUS_DEVICE_IFNO
       default n
       tristate "devinfo info feature oproject"
```

## drivers/soc/oplus/system/Kconfig
```kconfig
# SPDX-License-Identifier: GPL-2.0-only
# Copyright (C) 2018-2020 Oplus. All rights reserved.
config OPLUS_SYSTEM_KERNEL
  bool "config oplus system feature "
  default y
  help
	define this config to add oplus sytstem kernel feature
```

## mm/damon/Kconfig
```kconfig
# SPDX-License-Identifier: GPL-2.0-only

menu "Data Access Monitoring"

config DAMON
	bool "DAMON: Data Access Monitoring Framework"

config DAMON_PADDR
	bool "Data access monitoring operations for the physical address space"
	depends on DAMON && MMU
	select PAGE_IDLE_FLAG

config DAMON_RECLAIM
	bool "Build DAMON-based reclaim (DAMON_RECLAIM)"
	depends on DAMON_PADDR

endmenu
```

## mm/oplus_perf_mm/Kconfig
```kconfig
# SPDX-License-Identifier: GPL-2.0-only
# Copyright (C) 2018-2020 Oplus. All rights reserved.

config OPLUS_FEATURE_PERFORMANCE_MM
	bool "config oplus kernel mm feature"
	default y
	help
	  define this config to add oplus kernel mm feature

config OPLUS_FEATURE_ZRAM_OPT
	tristate "zram optimization"
	default n
	help
	  define this config to add oplus zram optimization feature

config VIRTUAL_RESERVE_MEMORY
	tristate "reserved vma for gpu emergency mmap"
	default m
	help
	  support reserved vma for gpu emergency mmap.

config PROCESS_RECLAIM_ENHANCE
	tristate "Enable process reclaim enchance"
	depends on PROC_FS
	default n
	help
	  It allows to reclaim different type pages.
	  Call ioctl of /proc/prpocess_reclaim to get memory range,
	  such as struct iovec.
	  Then call process_madvise() to reclaim or read-ahead memory.

config DUMP_TASKS_MEM
	tristate "dump all userspace process meminfo"
	default n
	help
	  dump all userspace process meminfo

config MEMLEAK_DETECT
	tristate "Enable kmalloc and vmalloc memleak detect feature"
	default n
	help
	  If kmalloc-* slab has memleak, will create a new kmalloc cache
	  with the same size but with SLAB_STORE_USER.
	  Record the vmalloc stack for debugging vmalloc memleak.

config DYNAMIC_TUNING_SWAPPINESS
	bool "tuning swappiess depends on file_pages size"
	default y
	help
	  Tuning swappiess depends on file_pages size.
	  If the file pages too much, kswapd will reclaim more file pages,
	  and support two levels.
	  Say N if you not sure.

source "mm/oplus_perf_mm/hybridswap_zram/Kconfig"
```
